## config/boards/shields/snn/Kconfig.defconfig
```kconfig
# Copyright (c) 2022 The ZMK Contributors
# SPDX-License-Identifier: MIT

if SHIELD_SNN_LEFT

config ZMK_KEYBOARD_NAME
	default "snn"

config ZMK_SPLIT_BLE_ROLE_CENTRAL
	default y

endif

if SHIELD_SNN_LEFT || SHIELD_SNN_RIGHT

config ZMK_SPLIT
	default y

endif
```

## config/boards/shields/snn/Kconfig.shield
```kconfig
# Copyright (c) 2022 The ZMK Contributors
# SPDX-License-Identifier: MIT

config SHIELD_SNN_LEFT
	def_bool $(shields_list_contains,snn_left)

config SHIELD_SNN_RIGHT
	def_bool $(shields_list_contains,snn_right)
```
